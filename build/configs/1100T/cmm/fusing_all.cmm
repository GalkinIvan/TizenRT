;------------------------------
;  Configuring JTAG interface
;-----------------------------

AREA.RESet
AREA.CREATE
AREA.SELECT
AREA.VIEW

LOCAL &BASE_DIR
&DIR=OS.PPD()				; get current dir
&BASE_DIR="&DIR"
GLOBAL &FLASH_BASE &BL1_FLASH_START &BL2_FLASH_START &OTA_BOOT_ARG_START &tinyARA_FLASH_START &led_FW_FLASH_START &sss_FW_FLASH_START &wlan_FW_FLASH_START &OTA_OFFSET &status_register

do erase_all.cmm

&BL1_FLASH_FILE="&BASE_DIR\..\..\..\configs\artik053\bin\bl1.bin"
&BL2_FLASH_FILE="&BASE_DIR\..\..\..\configs\artik053\bin\bl2.bin"
;&OTA_BOOT_ARG_FILE="&BASE_DIR\..\..\..\configs\sidk_s5jt200\boot_bin\t20.ota_bootarg.bin"
&tinyARA_FLASH_FILE="&BASE_DIR\..\..\..\output\bin\tinyara_head.bin"
;&led_FW_FLASH_FILE="&BASE_DIR\..\..\..\configs\sidk_s5jt200\boot_bin\t20.ledctrlblk.m0.bin"
&sss_FW_FLASH_FILE="&BASE_DIR\..\..\..\configs\artik053\bin\sssfw.bin"
&wlan_FW_FLASH_FILE="&BASE_DIR\..\..\..\configs\artik053\bin\wlanfw.bin"
&smartfs_FLASH_FILE="&BASE_DIR\..\..\..\configs\artik053\bin\artik051_smartfs.bin"

GOSUB	flash_init

;flash images
GOSUB flash_write &BL1_FLASH_FILE &BL1_FLASH_START
GOSUB flash_write &BL2_FLASH_FILE &BL2_FLASH_START
;GOSUB flash_write &OTA_BOOT_ARG_FILE &OTA_BOOT_ARG_START
GOSUB flash_write &tinyARA_FLASH_FILE &tinyARA_FLASH_START
;GOSUB flash_write &led_FW_FLASH_FILE &led_FW_FLASH_START;
;GOSUB flash_write &sss_FW_FLASH_FILE &sss_FW_FLASH_START
;GOSUB flash_write &wlan_FW_FLASH_FILE &wlan_FW_FLASH_START
GOSUB flash_write &smartfs_FLASH_FILE 0x04528000

;do enable_write_protect.cmm

enddo

;-----------------------------------------
flash_init:
	R.S PC 0x02020000
	print "Initialize Serial Flash Interface..."
	d.s SD:0x80040020 %LE %LONG 0x00222222 ;;GPCON
	d.s SD:0x80040028 %LE %LONG 0x00333333 ;;GPPUD
	d.s SD:0x80310004 %LE %LONG 0x8010000A ;;Disable WP
	RETURN
;-----------------------------------------
flash_write:
	ENTRY &file &fstart
	d.load.b &file &fstart
	RETURN
;-----------------------------------------
enable_region:
	PER.S.SI C15:0x26 %L 0x0 0x0 C15:0x16 %Long 0x0		;Region 0 off
	PER.S.SI C15:0x26 %L 0x0 0x0 C15:0x216 %Long 0x8	;32bytes but disable
	PER.S.SI C15:0x26 %L 0x1 0x1 C15:0x16 %Long 0x1		;Region 1 off
	PER.S.SI C15:0x26 %L 0x1 0x1 C15:0x216 %Long 0x8	;32bytes but disable
	PER.S.SI C15:0x26 %L 0x2 0x2 C15:0x16 %Long 0x2		;Region 2 off
	PER.S.SI C15:0x26 %L 0x2 0x2 C15:0x216 %Long 0x8	;32bytes but disable
	PER.S.SI C15:0x26 %L 0x3 0x3 C15:0x16 %Long 0x3		;Region 3 off
	PER.S.SI C15:0x26 %L 0x3 0x3 C15:0x216 %Long 0x8	;32bytes but disable
	PER.S.SI C15:0x26 %L 0x4 0x4 C15:0x16 %Long 0x4		;Region 4 off
	PER.S.SI C15:0x26 %L 0x4 0x4 C15:0x216 %Long 0x8	;32bytes but disable
	PER.S.SI C15:0x26 %L 0x5 0x5 C15:0x16 %Long 0x5		;Region 5 off
	PER.S.SI C15:0x26 %L 0x5 0x5 C15:0x216 %Long 0x8	;32bytes but disable
	PER.S.SI C15:0x26 %L 0x6 0x6 C15:0x16 %Long 0x6		;Region 6 off
	PER.S.SI C15:0x26 %L 0x6 0x6 C15:0x216 %Long 0x8	;32bytes but disable
	PER.S.SI C15:0x26 %L 0x7 0x7 C15:0x16 %Long 0x7		;Region 7 off
	PER.S.SI C15:0x26 %L 0x7 0x7 C15:0x216 %Long 0x8	;32bytes but disable
	PER.S.SI C15:0x26 %L 0x8 0x8 C15:0x16 %Long 0x8		;Region 8 off
	PER.S.SI C15:0x26 %L 0x8 0x8 C15:0x216 %Long 0x8	;32bytes but disable
	PER.S.SI C15:0x26 %L 0x9 0x9 C15:0x16 %Long 0x9		;Region 9 off
	PER.S.SI C15:0x26 %L 0x9 0x9 C15:0x216 %Long 0x8	;32bytes but disable
	PER.S.SI C15:0x26 %L 0xA 0xA C15:0x16 %Long 0xA		;Region 10 off
	PER.S.SI C15:0x26 %L 0xA 0xA C15:0x216 %Long 0x8	;32bytes but disable
	PER.S.SI C15:0x26 %L 0xB 0xB C15:0x16 %Long 0xB		;Region 11 off
	PER.S.SI C15:0x26 %L 0xB 0xB C15:0x216 %Long 0x8	;32bytes but disable

	PER.S.SI C15:0x26 %L 0x0 0x0 C15:0x416 %Long 0x300	;strongly ordered, non-shared
	PER.S.SI C15:0x26 %L 0x0 0x0 C15:0x216 %Long 0x3F	;4GB
	PER.S.SI C15:0x26 %L 0x0 0x0 C15:0x16 %Long 0x0

	PER.S.SI C15:0x26 %L 0x4 0x4 C15:0x416 %Long 0x310	;device
	PER.S.SI C15:0x26 %L 0x4 0x4 C15:0x216 %Long 0x31	;32MB
	PER.S.SI C15:0x26 %L 0x4 0x4 C15:0x16 %Long 0x60000000
	PER.Set C15:0x1 %Long 0x00e50879			;enable region
	RETURN
;-----------------------------------------
