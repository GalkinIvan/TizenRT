## apps/examples/codec_char_test/Kconfig
```kconfig
#
# For a description of the syntax of this configuration file,
# see the file kconfig-language.txt in the NuttX tools repository.
#

config EXAMPLE_ES_TEST
	bool "ES_TEST reference application"
	default n
	---help---
```

## os/arch/arm/src/1100T/Kconfig
```kconfig
if ARCH_BOARD_1100T

config 1100T_BOOT_FAILURE_DETECTION
	bool "Clear bootcount when boot completes"
	default y
	---help---
		BL2 sets up a watchdog before it jumps to TinyARA to detect
		boot failures. On a successful boot, the secondary OS should
		turn the watchdog off and clear the bootcount register that
		stores the number of tries to boot. Otherwise, the watchdog
		will bark and BL2 may go into recovery mode.

config 1100T_BOOT_COUNTS_ADDR
	hex "Address of scratch pad register to store the bootcount"
	default 0x80090810
	depends on 1100T_BOOT_FAILURE_DETECTION
	---help---
		The number of tries to boot will be stored in this address.
		On successful boot, it is cleared to zero. The register should
		be kept intact even on watchdog resets.

config 1100T_FLASH_CAPACITY
	int "Size of external flash memory (in bytes)"
	default 8388608
	depends on S5J_SFLASH
	---help---
		Sets the capacity of the external flash memory
		on the ARTIK-053 Starter Kit board.

config 1100T_FLASH_PAGE_SIZE
	int "Page size of external flash memory (in bytes)"
	default 4096
	depends on S5J_SFLASH
	---help---
		Sets the page size of the external flash memory on the
		ARTIK-053 Starter Kit board. It can be the size of erase
		unit flash memory supports.

config 1100T_FLASH_PART
	bool "Enable partition support on FLASH"
	default n
	select MTD
	select MTD_PARTITION
	select MTD_PROGMEM
	depends on S5J_SFLASH && !DISABLE_MOUNTPOINT
	---help---
		Enables creation of partitions on the FLASH

config 1100T_FLASH_MINOR
	int "Minor number for the FLASH device"
	default 0
	depends on 1100T_FLASH_PART
	---help---
		Sets the minor number for /dev node of the external flash
		device.

config 1100T_FLASH_PART_LIST
	string "Flash partition size list (in KBytes)"
	default "16,48,192,32,512,2400,1536,1536,1400,8,512,"
	depends on 1100T_FLASH_PART
	---help---
		Comma separated list of partition sizes in KB.

config 1100T_FLASH_PART_TYPE
	string "Flash partition type list"
	default "none,none,none,none,none,none,none,none,smartfs,config,none,"
	depends on 1100T_FLASH_PART
	---help---
		Comma separated list of partition types that can be one of
		followings: none, smartfs, config

config 1100T_FLASH_PART_NAME
	string "Flash partition name list"
	default "bl1,sssro,bl2,sssfw,wlanfw,os,factory,ota,user,nvram,sssrw,"
	depends on MTD_PARTITION_NAMES
	depends on 1100T_FLASH_PART
	---help---
		Comma separated list of partition names.

config 1100T_AUTOMOUNT
       bool "Automount partitions"
       default n
       depends on 1100T_FLASH_PART
       ---help---
		If enabled, mount userrw and sssrw partitions at boot.

config 1100T_AUTOMOUNT_USERFS
	bool "Automount user r/w partiton"
	default n
	depends on 1100T_AUTOMOUNT
	depends on FS_SMARTFS
	---help---
		If enabled, user r/w partition will be mounted automatically
		at boot.

config 1100T_AUTOMOUNT_USERFS_DEVNAME
	string "Device name of the partition for user r/w file system"
	default "/dev/smart0p8"
	depends on 1100T_AUTOMOUNT_USERFS
	---help---
		Specifies the device name (/dev/smart0pX) of the partition
		for user r/w file system.

config 1100T_AUTOMOUNT_USERFS_MOUNTPOINT
	string "Mountpoint of the partition for user r/w file system"
	default "/mnt"
	depends on 1100T_AUTOMOUNT_USERFS
	---help---
		Specifies the mount point where user r/w file system
		will be mounted at.

if RAMMTD
config 1100T_RAMMTD_NEBLOCKS
		int "RAM MTD erase block count"
		default 64
		---help---
				Ramfs size will be RAMMTD_ERASESIZE * SIDK_1100T_RAMMTD_NEBLOCKS.
				You have to consider total ramsize to alloc ramfs size.

config 1100T_RAMMTD_DEV_NUMBER
		int "device number for mtd of smartfs"
		default 3

config 1100T_RAMMTD_DEV_POINT
		string "Device name of the partition for ramfs r/w file system"
		default "/dev/smart3"

config 1100T_RAMMTD_MOUNT_POINT
		string "Mountpoint of the partition for ramfs r/w file system"
		default "/ramfs"
endif

config AUDIO_ES8388CHAR
	bool "ES8388 Character Driver (for testing and demo only)"
	depends on I2S && AUDIO && I2C && !AUDIO_ES8388
	---help---
		This selection enables a simple character driver that supports ES8388 codec
		transfers via a ioctl API.  The intent of this driver is to
		support ES8388 codec operation.  It is not an audio driver but does conform to
		some of the buffer management heuristics of an audio driver.  It can be used
		as real driver application with come restrictions.

if AUDIO_ES8388CHAR

config AUDIO_ES8388CHAR_RXTIMEOUT
	int "RX timeout"
	default 0
	---help---
		This is a fixed timeout value that will be used for all receiver
		transfers.  This is in units of system clock ticks (configurable).
		The special value of zero disables RX timeouts.  Default: 0

config AUDIO_ES8388CHAR_TXTIMEOUT
	int "TX timeout"
	default 0
	---help---
		This is a fixed timeout value that will be used for all transmitter
		transfers.  This is in units of system clock ticks (configurable).
		The special value of zero disables RX timeouts.  Default: 0

endif # AUDIO_ES8388CHAR

config AUDIO_ES8388
	bool "ES8388 audio chip"
	depends on AUDIO
	---help---
		Select to enable support for the ES8388 Audio codec by Realtek
		NOTE: This driver also depends on both I2C and I2S support although
		that dependency is not explicit here.

if AUDIO_ES8388

config ES8388_INITVOLUME
	int "ES8388 initial volume setting"
	default 250

config ES8388_INFLIGHT
	int "ES8388 maximum in-flight audio buffers"
	default 2

config ES8388_MSG_PRIO
	int "ES8388 message priority"
	default 1

config ES8388_BUFFER_SIZE
	int "ES8388 preferred buffer size"
	default 8192

config ES8388_NUM_BUFFERS
	int "ES8388 preferred number of buffers"
	default 4

config ES8388_WORKER_STACKSIZE
	int "ES8388 worker thread stack size"
	default 768

config ES8388_REGDUMP
	bool "ES8388 register dump"
	default n
	---help---
		Enable logic to dump the contents of all ES8388 registers.

config ES8388_CLKDEBUG
	bool "ES8388 clock analysis"
	default n
	---help---
		Enable logic to analyze ES8388 clock configuation.

endif # AUDIO_ES8388



endif
```
